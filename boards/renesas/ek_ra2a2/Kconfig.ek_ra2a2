## boards/renesas/ek_ra2a2/Kconfig.ek_ra2a2
```kconfig
# Copyright (c) 2025 Renesas Electronics Corporation and/or its affiliates
# SPDX-License-Identifier: Apache-2.0

config BOARD_EK_RA2A2
	select SOC_R7FA2A2AD3CFP
```

## boards/renesas/ek_ra2a2/board.yml
```yaml
board:
  name: ek_ra2a2
  full_name: RA2A2 Evaluation Kit
  vendor: renesas
  socs:
  - name: r7fa2a2ad3cfp
```

## soc/renesas/ra/ra2a2/Kconfig.soc
```kconfig
# Copyright (c) 2025 Renesas Electronics Corporation and/or its affiliates
# SPDX-License-Identifier: Apache-2.0

config SOC_SERIES_RA2A2
	bool
	select SOC_FAMILY_RENESAS_RA
	help
	  Renesas RA2A2 series

config SOC_R7FA2A2AD3CFP
	bool
	select SOC_SERIES_RA2A2
	help
	  R7FA2A2AD3CFP

config SOC_SERIES
	default "ra2a2" if SOC_SERIES_RA2A2

config SOC
	default "r7fa2a2ad3cfp" if SOC_R7FA2A2AD3CFP
```
